## src/drivers/tslib/Kconfig
```kconfig
config LV_USE_TSLIB
	bool "tslib"
	default n
	help
		Read touch input through tslib. tslib must be available in the build. The touchscreen has to be configured for tslib, e.g. via `ts_uenv`.
```

## src/image/Kconfig
```kconfig
menu "Image Settings"

config LV_CACHE_DEF_SIZE
	int "Default image cache size (bytes, 0 = disabled)"
	default 0
	help
		Avoids repeatedly opening and decoding the same images, at the cost of RAM.
		Of little benefit with only the built-in image formats.

config LV_IMAGE_HEADER_CACHE_DEF_CNT
	int "Default image header cache size (entries, 0 = disabled)"
	default 0
	help
		Avoids repeatedly reading image headers, at the cost of RAM.
		Of little benefit with only the built-in image formats.

config LV_USE_RLE
	bool "RLE compression"
	help
		Decoder for LVGL's run-length encoded binary image format.

config LV_USE_LZ4
	bool "LZ4 compression"
	default n
	help
		LZ4 compress/decompress functions, used by LVGL's compressed binary images.

config LV_USE_LZ4_INTERNAL
	bool "Bundled LZ4"
	depends on LV_USE_LZ4
	default y

config LV_BIN_DECODER_RAM_LOAD
	bool "Decode binary images to RAM"
	default n

config LV_USE_LODEPNG
	bool "PNG decoder (LodePNG)"

config LV_USE_LIBPNG
	bool "PNG decoder (libpng)"

config LV_USE_BMP
	bool "BMP decoder"

config LV_USE_TJPGD
	bool "JPEG decoder (TJpgDec)"
	help
		Also decodes split JPEG, a custom format optimized for embedded systems.

config LV_USE_LIBJPEG_TURBO
	bool "JPEG decoder (libjpeg-turbo)"
	help
		High-performance decoder supporting the complete JPEG specifications.

config LV_USE_LIBWEBP
	bool "WebP decoder"

config LV_USE_STB_IMAGE
	bool "Image decoder (stb_image)"
	help
		JPEG/PNG/BMP/GIF/PSD/PNM/TGA decoder based on the bundled stb_image.
		SIMD paths are enabled automatically per target: SSE2 on x86/x64,
		NEON on ARM, RVV on RISC-V. Define STBI_NO_SIMD to force scalar code.
		Stb_image acts as a fallback: if another decoder (LodePNG, TJpgDec,
		...) is also enabled and claims the format first, that one wins.

if LV_USE_STB_IMAGE
config LV_STB_IMAGE_JPEG
	bool "JPEG"
	default y

config LV_STB_IMAGE_PNG
	bool "PNG"
	default y

config LV_STB_IMAGE_BMP
	bool "BMP"
	default y

config LV_STB_IMAGE_GIF
	bool "GIF (first frame only)"
	default y

config LV_STB_IMAGE_PSD
	bool "PSD"
	default y

config LV_STB_IMAGE_PIC
	bool "PIC (Softimage)"
	default y

config LV_STB_IMAGE_PNM
	bool "PNM (binary PGM/PPM)"
	default y

config LV_STB_IMAGE_HDR
	bool "HDR (radiance)"
	default y

config LV_STB_IMAGE_TGA
	bool "TGA"
	default y

choice LV_STB_IMAGE_SIMD
	prompt "SIMD acceleration"
	default LV_STB_IMAGE_SIMD_SCALAR
	help
		Nothing is enabled automatically. Each choice only takes effect when
		it matches the target architecture and compiler flags; a mismatch
		falls back to scalar code with a compile-time warning.

	config LV_STB_IMAGE_SIMD_SCALAR
		bool "None (scalar)"
	config LV_STB_IMAGE_SIMD_SSE2
		bool "SSE2 (x86/x64)"
	config LV_STB_IMAGE_SIMD_NEON
		bool "NEON (ARM)"
		help
			Requires building with NEON enabled, e.g. -mfpu=neon.
	config LV_STB_IMAGE_SIMD_RVV
		bool "RVV (RISC-V)"
		help
			Supports RVV 1.0 toolchains, and RVV 0.7.1 with legacy
			toolchains (-D__riscv_vector_071). Requires building with the
			vector extension, e.g. -march=rv64gcv.
endchoice
endif #LV_USE_STB_IMAGE

config LV_USE_SVG
	bool "SVG"
	depends on LV_DRAW_HAS_VECTOR_SUPPORT
	select LV_USE_VECTOR_GRAPHIC

if LV_USE_SVG
config LV_USE_SVG_ANIMATION
	bool "SVG animation"

config LV_USE_SVG_DEBUG
	bool "SVG debug logs"
	default n
endif #LV_USE_SVG

endmenu
```
